
#include QMK_KEYBOARD_H
#include <stdio.h>

#define RGB_COUNT 18
#define METER_LED_COUNT 8


///// define the variables /////



enum custom_keycodes {
    ENC_MOD = SAFE_RANGE,
    PROF_NEXT,
    PROF_PREV,
    SCR_LEFT,
    SCR_RIGHT,
    HCK_RGB,
    NVIDIA,
    REPLAY,
};

static bool enc_mod = false;
static uint16_t enc_indicator_timer = 0;
static bool enc_recently_used = false;

#define ENC_INDICATOR_TIMEOUT 500  // ms the red/white/red bar stays on after turning encoder


///// RGB effect state /////
// 0 = teal
// 1 = white
// 2 = rainbow radial
// 3 = purple / white / blue effect
// 4 = off

static uint8_t rgb_effect_mode = 0;



///// getting CPU/GPU % /////



// placeholder values until script to send over USB is complete
__attribute__((unused)) static uint8_t raw_cpu_usage = 88;
__attribute__((unused)) static uint8_t raw_gpu_usage = 88;
__attribute__((unused)) static uint8_t pc_vol = 50;
__attribute__((unused)) static uint8_t pc_bright = 50;



/////bitmaps/////



// empty bitmap
static const uint8_t PROGMEM empty_bitmap[] = {
0xff, 0xff, 0xff, 0x80, 0x00, 0x00, 0x00, 0x00, 0x00, 0x00, 0x00, 0x00, 0x03, 0xff, 0xff, 0xff, 
0xff, 0xff, 0xff, 0x9f, 0xff, 0xff, 0xcf, 0xff, 0xff, 0xe7, 0xff, 0xff, 0xf3, 0xff, 0xff, 0xff, 
0xff, 0xff, 0xff, 0x9f, 0xff, 0xff, 0xcf, 0xff, 0xff, 0xe7, 0xff, 0xff, 0xf3, 0xff, 0xff, 0xff, 
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0xff, 0xff, 0xff, 0x80, 0x00, 0x00, 0x00, 0x00, 0x00, 0x00, 0x00, 0x00, 0x03, 0xff, 0xff, 0xff
};

// Home bitmap
static const uint8_t PROGMEM home_bitmap[] = {
0xff, 0xff, 0xff, 0x80, 0x00, 0x00, 0x00, 0x00, 0x00, 0x00, 0x00, 0x00, 0x03, 0xff, 0xff, 0xff, 
0xff, 0xff, 0xff, 0x9f, 0xff, 0xff, 0xcf, 0xff, 0xff, 0xe7, 0xff, 0xff, 0xf3, 0xff, 0xff, 0xff, 
0xff, 0xff, 0xff, 0x9f, 0xff, 0xff, 0xcf, 0xff, 0xff, 0xe7, 0xff, 0xff, 0xf3, 0xff, 0xff, 0xff, 
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0xff, 0xff, 0xff, 0x80, 0x00, 0x00, 0x00, 0x00, 0x00, 0x00, 0x00, 0x00, 0x03, 0xff, 0xff, 0xff
};

// Gaming bitmap
static const uint8_t PROGMEM gaming_bitmap[] = {
0xff, 0xff, 0xff, 0x80, 0x00, 0x00, 0x00, 0x00, 0x00, 0x00, 0x00, 0x00, 0x03, 0xff, 0xff, 0xff, 
0xff, 0xff, 0xff, 0x9f, 0xff, 0xff, 0xcf, 0xff, 0xff, 0xe7, 0xff, 0xff, 0xf3, 0xff, 0xff, 0xff, 
0xff, 0xff, 0xff, 0x9f, 0xff, 0xff, 0xcf, 0xff, 0xff, 0xe7, 0xff, 0xff, 0xf3, 0xff, 0xff, 0xff, 
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0xff, 0xff, 0xff, 0x80, 0x00, 0x00, 0x00, 0x00, 0x00, 0x00, 0x00, 0x00, 0x03, 0xff, 0xff, 0xff
};

// media bitmap
static const uint8_t PROGMEM media_bitmap[] = {
0xff, 0xff, 0xff, 0x80, 0x00, 0x00, 0x00, 0x00, 0x00, 0x00, 0x00, 0x00, 0x03, 0xff, 0xff, 0xff, 
0xff, 0xff, 0xff, 0x9f, 0xff, 0xff, 0xcf, 0xff, 0xff, 0xe7, 0xff, 0xff, 0xf3, 0xff, 0xff, 0xff, 
0xff, 0xff, 0xff, 0x9f, 0xff, 0xff, 0xcf, 0xff, 0xff, 0xe7, 0xff, 0xff, 0xf3, 0xff, 0xff, 0xff, 
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0xff, 0xff, 0xff, 0x80, 0x00, 0x00, 0x00, 0x00, 0x00, 0x00, 0x00, 0x00, 0x03, 0xff, 0xff, 0xff
};



///// Profile switching code /////



const uint16_t PROGMEM keymaps[][MATRIX_ROWS][MATRIX_COLS] = {

    // 0 = base
    [0] = LAYOUT_ortho_3x3(
        C(KC_Z),    HCK_RGB,    C(KC_Y),
        SCR_LEFT,   KC_P0,      SCR_RIGHT,
        PROF_PREV,  PROF_NEXT,  ENC_MOD
    ),

    // 1 = screen + media control
    [1] = LAYOUT_ortho_3x3(
        KC_MPRV,    KC_MPLY,    KC_MNXT,
        KC_PSCR,    REPLAY,     NVIDIA,
        KC_TRNS,    KC_TRNS,    KC_TRNS
    ),

    // 2 = Numpad1
    [2] = LAYOUT_ortho_3x3(
        KC_P1,      KC_P2,      KC_P3,
        KC_P4,      KC_P5,      KC_P6,
        KC_TRNS,    KC_TRNS,    KC_TRNS
    ),

    // 3 = Numpad2
    [3] = LAYOUT_ortho_3x3(
        KC_P7,      KC_P8,      KC_P9,
        KC_PSLS,    KC_PAST,    KC_PPLS,
        KC_TRNS,    KC_TRNS,    KC_TRNS
    ),

    // 4 = Gaming
    [4] = LAYOUT_ortho_3x3(
        KC_Q,       KC_W,       KC_E,
        KC_A,       KC_S,       KC_D,
        KC_TRNS,    KC_TRNS,    KC_TRNS
    )
};



///// RGB code /////

// Encoder volume/brightness meter

static void apply_rgb_effect(void) {

    uint8_t leds_on_vol = ((uint16_t)pc_vol * METER_LED_COUNT) / 100;
    uint8_t leds_on_bright = ((uint16_t)pc_bright * METER_LED_COUNT) / 100;
    uint8_t leds_on;


    if (enc_recently_used && timer_elapsed(enc_indicator_timer) < ENC_INDICATOR_TIMEOUT) {

        rgblight_enable_noeeprom();
        rgblight_mode_noeeprom(RGBLIGHT_MODE_STATIC_LIGHT);


        for (uint8_t i = 0; i < METER_LED_COUNT; i++) {
            rgblight_setrgb_at(0, 0, 0, i);
        }


        if (enc_mod) {
            leds_on = leds_on_bright;
        } else {
            leds_on = leds_on_vol;
        }


        for (uint8_t i = 0; i < leds_on; i++) {

            if (enc_mod) {
                rgblight_setrgb_at(255, 180, 0, i);
            } else {
                rgblight_setrgb_at(0, 120, 255, i);
            }
        }


    } else {

        switch (rgb_effect_mode) {


            case 0:

                rgblight_enable_noeeprom();
                rgblight_mode_noeeprom(RGBLIGHT_MODE_STATIC_LIGHT);

                for (uint8_t i = 8; i < RGB_COUNT; i++) {
                    rgblight_setrgb_at(0, 180, 150, i);
                }

                break;



            case 1:

                rgblight_enable_noeeprom();
                rgblight_mode_noeeprom(1);
                rgblight_setrgb(255,255,255);

                break;



            case 2:

                rgblight_enable_noeeprom();
                rgblight_mode_noeeprom(5);  

                break;



            case 3:

                rgblight_enable_noeeprom();
                rgblight_mode_noeeprom(RGBLIGHT_MODE_STATIC_LIGHT);


                for (uint8_t i = 8; i < RGB_COUNT; i++) {
                    rgblight_setrgb_at(0,0,0,i);
                }


                rgblight_setrgb_at(180,0,255,8);
                rgblight_setrgb_at(255,255,255,9);
                rgblight_setrgb_at(0,80,255,10);

                break;



            case 4:

                rgblight_disable_noeeprom();

                break;
        }
    }
}

// Automatically return from meter mode after timeout
void housekeeping_task_user(void) {

    if (enc_recently_used && timer_elapsed(enc_indicator_timer) > ENC_INDICATOR_TIMEOUT) {

        enc_recently_used = false;

        #ifdef RGBLIGHT_ENABLE
            apply_rgb_effect();
        #endif
    }
}



void keyboard_post_init_user(void) {
    apply_rgb_effect();
}



layer_state_t layer_state_set_user(layer_state_t state) {

    // Prevent layer changes overwriting encoder meter
    if (!enc_recently_used) {
        apply_rgb_effect();
    }

    return state;
}



///// Key handling code /////



bool process_record_user(uint16_t keycode, keyrecord_t *record) {
    switch (keycode) {

        case PROF_NEXT:
            if (record->event.pressed) {
                layer_move((get_highest_layer(layer_state) + 1) % 5);
            }
            return false;

        case PROF_PREV:
            if (record->event.pressed) {
                layer_move((get_highest_layer(layer_state) + 4) % 5);
            }
            return false;

        case ENC_MOD:
            enc_mod = record->event.pressed;
            return false;

        case SCR_LEFT:
            if (record->event.pressed) {
                tap_code16(C(G(KC_LEFT)));
            }
            return false;

        case SCR_RIGHT:
            if (record->event.pressed) {
                tap_code16(C(G(KC_RIGHT)));
            }
            return false;

        case HCK_RGB:
            if (record->event.pressed) {
                rgb_effect_mode = (rgb_effect_mode + 1) % 5;
                #ifdef RGBLIGHT_ENABLE
                    apply_rgb_effect();
                #endif
            }
            return false;

        case NVIDIA:
            if (record->event.pressed) {
                tap_code16(A(KC_Z));   // Alt+Z
            }
            return false;

        case REPLAY:
            if (record->event.pressed) {
                tap_code16(A(KC_F10)); // Alt+F10
            }
            return false;
    }
    return true;
}



///// Encoder code /////



#ifdef ENCODER_ENABLE
bool encoder_update_user(uint8_t index, bool clockwise) {
    (void)index;

    // Mark that the encoder was recently used
    enc_recently_used = true;
    enc_indicator_timer = timer_read();

    #ifdef RGBLIGHT_ENABLE
        apply_rgb_effect();
    #endif

    if (enc_mod) {
        if (clockwise) {
            tap_code16(G(A(KC_PGUP)));   // Win+Alt+PgUp
        } else {
            tap_code16(G(A(KC_PGDN)));   // Win+Alt+PgDn
        }
    } else {
        if (clockwise) {
            tap_code(KC_VOLU);
        } else {
            tap_code(KC_VOLD);
        }
    }

    return false;
}
#endif



///// OLED code /////



#ifdef OLED_ENABLE

bool oled_task_user(void) {
    uint8_t layer = get_highest_layer(layer_state);

    switch (layer) {
        case 0: // Home
            oled_write_raw_P((const char *)home_bitmap, sizeof(home_bitmap));
            break;

        case 1: // Media
            oled_write_raw_P((const char *)media_bitmap, sizeof(media_bitmap));
            break;

        case 2: // numpad 1, oled is empty
            oled_write_raw_P((const char *)empty_bitmap, sizeof(empty_bitmap));
            oled_set_cursor(7, 1);
            oled_write("NUMPAD A", false);
            break;

        case 3: // numpad 2, oled is empty
            oled_write_raw_P((const char *)empty_bitmap, sizeof(empty_bitmap));
            oled_set_cursor(7, 1);
            oled_write("NUMPAD B", false);
            break;


        case 4: // Gaming
            oled_write_raw_P((const char *)gaming_bitmap, sizeof(gaming_bitmap));
            break;

        default:
            oled_write_raw_P((const char *)empty_bitmap, sizeof(empty_bitmap));
            break;
    }

    //oled cpu/gpu util code

    //clamp cpu/gpu util to 0-99% 
    char buf [4]; 
    uint8_t cpu_usage = (raw_cpu_usage >=100) ? 99 : raw_cpu_usage;
    uint8_t gpu_usage = (raw_gpu_usage >=100) ? 99 : raw_gpu_usage;

    oled_set_cursor(1, 2);
    snprintf(buf, sizeof(buf), "%02d", cpu_usage);
    oled_write(buf, false);

    oled_set_cursor(18, 2);
    snprintf(buf, sizeof(buf), "%02d", gpu_usage);
    oled_write(buf, false);  


    return false;
}
// need to add cpu/gpu util script to send it through the usb port. 


#endif


/////Import CPU/GPU/Brightness/Volume data from host computer/////



#ifdef RAW_ENABLE
void raw_hid_receive(uint8_t *data, uint8_t length) {
    // Expected packet format:
    // data[0] = cpu
    // data[1] = gpu
    // data[2] = volume
    // data[3] = brightness

    if (length < 4) return;

    raw_cpu_usage = data[0];
    raw_gpu_usage = data[1];
    pc_vol        = data[2];
    pc_bright     = data[3];

    // Clamp values (just in case)
    if (raw_cpu_usage > 100) raw_cpu_usage = 100;
    if (raw_gpu_usage > 100) raw_gpu_usage = 100;
    if (pc_vol > 100) pc_vol = 100;
    if (pc_bright > 100) pc_bright = 100;
    if (raw_cpu_usage < 0) raw_cpu_usage = 0;
    if (raw_gpu_usage < 0) raw_gpu_usage = 0;
    if (pc_vol < 0) pc_vol = 0;
    if (pc_bright < 0) pc_bright = 0;
}
#endif